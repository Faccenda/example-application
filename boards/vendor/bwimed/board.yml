## boards/vendor/bwimed/board.yml
```yaml
# Copyright (c) 2024 Nordic Semiconductor ASA
# SPDX-License-Identifier: Apache-2.0

board:
  name: bwimed
  vendor: vendor
  socs:
    - name: wimed
```

## soc/gaph/wimed/Kconfig
```kconfig
config SOC_WIMED
	select RISCV
	select RISCV_ISA_RV32I
	select RISCV_ISA_EXT_M
	select RISCV_ISA_EXT_C
	select RISCV_ISA_EXT_ZICSR

	
```

## soc/gaph/wimed/Kconfig.defconfig
```kconfig
if SOC_WIMED

config RISCV_GP
	default y

config SYS_CLOCK_HW_CYCLES_PER_SEC
	default 10000000

config SYS_CLOCK_EXISTS
	default n

config NUM_IRQS
	default 1

config GEN_ISR_TABLES
	default n
	
endif
```
