/*
 * Copyright (c) 2021 Nordic Semiconductor ASA
 * SPDX-License-Identifier: Apache-2.0
 */

/dts-v1/;
#include "../dts/gaph/wimed.dtsi"

/ {
	chosen {
		zephyr,sram = &ram0;
		zephyr,flash = &flash0;
	};
};
